## Documentation/devicetree/bindings/crypto/nxp,se050.yaml.yaml
```yaml
# SPDX-License-Identifier: (GPL-2.0-only OR BSD-2-Clause)
%YAML 1.2
---
$id: http://devicetree.org/schemas/crypto/xlnx,zynqmp-aes.yaml#
$schema: http://devicetree.org/meta-schemas/core.yaml#

title: NXP SE050 Secure Element Device Tree Bindings

maintainers:
  - Anirban Bose <abose@outerspace.co>

description: |
  Device tree bindings for the NXP SE050 secure element connected over I2C, which
  provides cryptographic operations and secure storage.

properties:
  compatible:
    const: "nxp,se050"

  reg:
    description: |
      The I2C address of the SE050 device.

  vcc-supply:
    description: |
      Power supply for the SE050.
    $ref: "/schemas/types.yaml#/definitions/phandle"

  reset-gpios:
    description: |
      Optional GPIO used to reset the SE050 device.
    $ref: "/schemas/types.yaml#/definitions/phandle-array"

  status:
    description: |
      Device status, enabled or disabled.
    enum: ["okay", "disabled"]

required:
  - compatible
  - reg
  - vcc-supply

additionalProperties: false

examples:
  - |
    i2c@1 {
        se050: secure-element@48 {
            compatible = "nxp,se050";
            reg = <0x48>; /* I2C address of SE050 */
            vcc-supply = <&reg_3v3>; /* Power supply */
            reset-gpios = <&gpio1 2 GPIO_ACTIVE_LOW>; /* Optional reset GPIO */
            status = "okay";
        };
    };
...
```

## Documentation/devicetree/bindings/iio/adc/adi,ade9112.yaml
```yaml
# SPDX-License-Identifier: (GPL-2.0-only OR BSD-2-Clause)
%YAML 1.2
---
$id: "http://devicetree.org/schemas/iio/adc/adi,ade9112.yaml#"
$schema: "http://devicetree.org/meta-schemas/core.yaml#"

title: Analog Devices ADE9112 Energy Metering IC Device Tree Bindings

maintainers:
  - Anirban Bose <abose@outerspace.co>

description: |
  Device tree bindings for the Analog Devices ADE9112 energy metering IC, which is 
  connected over an SPI interface and may include optional interrupt and power 
  configuration.

properties:
  compatible:
    const: "adi,ade9112"

  reg:
    description: |
      The chip select address for the ADE9112 device on the SPI bus.
    maxItems: 1

  spi-max-frequency:
    description: |
      Maximum SPI clock frequency in Hz.
    minimum: 1
    maximum: 10000000  # 10 MHz maximum

  irq-gpios:
    description: |
      Optional GPIO to use for interrupt signaling.
    $ref: "/schemas/types.yaml#/definitions/phandle-array"

  status:
    description: |
      Device status, either enabled or disabled.
    enum: ["okay", "disabled"]

required:
  - compatible
  - reg
  - spi-max-frequency

additionalProperties: false

examples:
  - |
    spi@0 {
        ade9112: energy-meter@0 {
            compatible = "adi,ade9112";
            reg = <0>; /* Chip select 0 */
            spi-max-frequency = <1000000>; /* Maximum SPI frequency 1 MHz */
            irq-gpios = <&gpio4 15 GPIO_ACTIVE_LOW>; /* Optional interrupt GPIO */
            status = "okay";
        };
    };
```

## Documentation/devicetree/bindings/net/microchip,lan9354.yaml
```yaml
# SPDX-License-Identifier: GPL-2.0-only OR BSD-2-Clause
%YAML 1.2
---
$id: "http://devicetree.org/schemas/net/microchip,lan9354.yaml#"
$schema: "http://devicetree.org/meta-schemas/core.yaml#"

title: Microchip LAN9354 Ethernet Switch

maintainers:
  - Anirban Bose <abose@outerspace.co>

description: |
  The LAN9354 is a high-performance, compact, and fully featured 3-port managed Ethernet switch 
  developed by Microchip Technology. It is designed for consumer, embedded, and industrial 
  electronic applications that require integrated and cost-effective Ethernet switching capabilities. 

properties:
  compatible:
    enum:
      - microchip,lan9354

  reg:
    maxItems: 1
    description: |
      Address of the device on the MDIO or SPI bus.

  interrupt-parent:
    description: |
      Phandle to the parent interrupt controller.
    $ref: "/schemas/types.yaml#/definitions/phandle"

  interrupts:
    maxItems: 1
    description: |
      The interrupt line for the LAN9354.

  reset-gpios:
    description: |
      GPIO specifier for the reset signal.
    $ref: "/schemas/types.yaml#/definitions/phandle-array"

  mdio:
    type: object
    description: |
      MDIO bus container if the LAN9354 is acting as an MDIO bus master.

    properties:
      "#address-cells":
        const: 1
      "#size-cells":
        const: 0

      ethernet-phy@0:
        type: object
        description: |
          PHY node connected to port 0 of the switch.

      ethernet-phy@1:
        type: object
        description: |
          PHY node connected to port 1 of the switch.

      ethernet-phy@2:
        type: object
        description: |
          PHY node connected to port 2 of the switch.

required:
  - compatible
  - reg

additionalProperties: false

examples:
  - |
    eth_switch@0 {
        compatible = "microchip,lan9354";
        reg = <0>;
        interrupt-parent = <&gpio>;
        interrupts = <5 IRQ_TYPE_LEVEL_LOW>;
        reset-gpios = <&gpio 10 GPIO_ACTIVE_LOW>;

        mdio {
            #address-cells = <1>;
            #size-cells = <0>;

            ethernet-phy@0 {
                reg = <0>;
            };
            ethernet-phy@1 {
                reg = <1>;
            };
            ethernet-phy@2 {
                reg = <2>;
            };
        };
    };

...
```

## Documentation/devicetree/bindings/usb/ti,tps25750.yaml
```yaml
# SPDX-License-Identifier: (GPL-2.0-only OR BSD-2-Clause)
%YAML 1.2
---
$id: "http://devicetree.org/schemas/usb/ti,tps25750.yaml#"
$schema: "http://devicetree.org/meta-schemas/core.yaml#"

title: Texas Instruments TPS25750 USB Type-C and Power Delivery Controller

maintainers:
  - Anirban Bose <abose@outerspace.co>

description: |
  Device tree bindings for the Texas Instruments TPS25750 and TPS25751 USB Type-C
  and Power Delivery (PD) controllers

properties:
  compatible:
    enum:
      - "ti,tps25750"

  reg:
    description: |
      The I2C address of the TPS25750 or TPS25751 device.
    maxItems: 1

  interrupt-parent:
    description: |
      Phandle to the parent interrupt controller.
    $ref: "/schemas/types.yaml#/definitions/phandle"

  interrupts:
    description: |
      The interrupt line for the TPS25750 or TPS25751, typically used for signaling events.
    maxItems: 1

  enable-gpios:
    description: |
      Optional GPIO to enable or disable the TPS25750/51 device.
    $ref: "/schemas/types.yaml#/definitions/phandle-array"

  status:
    description: |
      Device status, enabled or disabled.
    enum: ["okay", "disabled"]

required:
  - compatible
  - reg

additionalProperties: false

examples:
  - |
    i2c@1 {
        tps25751: pd-controller@24 {
            compatible = "ti,tps25750";
            reg = <0x24>; /* I2C address of the TPS25751 */
            interrupt-parent = <&gpio2>;
            interrupts = <5 IRQ_TYPE_EDGE_FALLING>; /* Interrupt on GPIO2 pin 5 */
            enable-gpios = <&gpio1 4 GPIO_ACTIVE_HIGH>; /* Optional enable GPIO */
            status = "okay";
        };
    };
```
